## adc/Kconfig
```kconfig
config SUBMOD_ADC_HAL
	bool "Enable STM32 HAL ADC for adc submodule"
	default y
	select USE_STM32_HAL_ADC
	select USE_STM32_HAL_ADC_EX
    select USE_STM32_HAL_DMA
	select USE_STM32_HAL_DMA_EX
```

## dac/Kconfig
```kconfig
config SUBMOD_DAC_HAL
	bool "Enable STM32 HAL DAC for dac submodule"
	default y
	select USE_STM32_HAL_DAC
	select USE_STM32_HAL_DAC_EX
    select USE_STM32_HAL_DMA
	select USE_STM32_HAL_DMA_EX
```
